## CMakeLists.txt
```
# devkit/CMakeLists.txt
# Phase 5D platform critical-section boundary — STM32F411E-DISCO.
# Target: stm32f411e_disco
# Purpose: runtime skeleton with RobotOS core + event queue + dispatcher integration.
#          Zephyr platform log adapter bridges core to Zephyr logging subsystem.
#          Zephyr platform time adapter bridges devkit_runtime sleep to k_msleep.
#          Zephyr platform fault adapter provides severity-graded fault reporting.

cmake_minimum_required(VERSION 3.20.0)

find_package(Zephyr REQUIRED HINTS $ENV{ZEPHYR_BASE})

project(robotos_devkit)

target_include_directories(app PRIVATE
    ../core
    ../platform
)

target_sources(app PRIVATE
    src/main.c
    src/devkit_status_led.c
    src/devkit_runtime.c
    src/devkit_build_info.c
    src/devkit_fault.c
    src/devkit_observability.c
    src/devkit_timer_producer.c
    src/devkit_button_producer.c
    src/devkit_uart_producer.c
    src/devkit_app_state.c
    src/devkit_probe_adapter.c
    ../core/robotos_core.c
    ../core/robotos_event_queue.c
    ../core/robotos_event_dispatcher.c
    ../platform/zephyr/robotos_platform_log_zephyr.c
    ../platform/zephyr/robotos_platform_time_zephyr.c
    ../platform/zephyr/robotos_platform_fault_zephyr.c
    ../platform/zephyr/robotos_platform_critical_zephyr.c
)

# Architecture-A Framework (Phase 12K build admission)
target_sources(app PRIVATE
    ../framework/robotos_fw_fsm.c
    ../framework/robotos_fw_event_bridge.c
    ../app/probe_translator/probe_translator.c
)

target_include_directories(app PRIVATE
    ../framework
    ../app/probe_translator
)
```

## prj.conf
```kconfig
# devkit/prj.conf
# Minimal Kconfig for STM32F411E-DISCO devkit bring-up.
# LOG via RTT (no USB-UART needed — reads through existing STLink debug USB).

# Logging
CONFIG_LOG=y
CONFIG_LOG_DEFAULT_LEVEL=3
CONFIG_LOG_PROCESS_THREAD_STACK_SIZE=1536
CONFIG_LOG_BACKEND_UART=n
CONFIG_LOG_BACKEND_RTT=y

# RTT (Segger J-Link RTT — supported by openocd xpack)
CONFIG_USE_SEGGER_RTT=y
CONFIG_SEGGER_RTT_BUFFER_SIZE_UP=4096

# GPIO (for LED blink)
CONFIG_GPIO=y

# Shell stays disabled (no command/CLI subsystem in Phase 9B).
CONFIG_SHELL=n

# Phase 9B: enable serial + interrupt-driven UART API for the devkit-local
# UART RX event producer (devkit_uart_producer.c). Uses external USB-UART
# adapter wired to PA3 (board RX). RTT remains the canonical log backend;
# UART is NOT used for logging or console I/O.
#
#   CONFIG_SERIAL=y                  # build the Zephyr serial driver
#   CONFIG_UART_INTERRUPT_DRIVEN=y   # uart_irq_callback_set / uart_fifo_read
#   CONFIG_UART_CONSOLE=n            # do NOT route console to UART (RTT only)
CONFIG_SERIAL=y
CONFIG_UART_INTERRUPT_DRIVEN=y
CONFIG_UART_CONSOLE=n

# Disable CTF tracing
CONFIG_TRACING=n

# Phase 11D: on-board MEMS accelerometer probe (LSM303AGR, lis2dh driver,
# I2C1 @ 0x19). Adapter-level probe. No floating-point printf; no SPI;
# no ADC; no Kconfig overrides for range/ODR/HP/trigger (driver defaults
# are used). LIS2DH_TRIGGER_NONE is the first option of choice
# LIS2DH_TRIGGER_MODE -> selected by default; no explicit override added.
# See PHASE_11C_ACCEL_PROBE_SPEC.md §D for the frozen config rules.
CONFIG_I2C=y
CONFIG_SENSOR=y
```

## src/main.c
```c
/*
 * devkit/src/main.c
 * RobotOS devkit — Phase 3A runtime skeleton entry point.
 * Thin: initializes runtime, enters runtime loop.
 */

#include "devkit_runtime.h"

int main(void)
{
	if (devkit_runtime_init() < 0) {
		return -1;
	}

	devkit_runtime_run(); /* does not return */
}
```

## src/devkit_app_state.c
```c
/*
 * devkit_app_state.c
 * RobotOS devkit minimal application state machine (Phase 9C) — devkit-local.
 *
 * See devkit_app_state.h for the public contract and architectural intent.
 *
 * Implementation notes:
 *   - All entry points are called from a single thread context: the core
 *     dispatcher thread (via the button/UART producer handlers) and the
 *     devkit runtime thread (via init / periodic log). No locks or volatiles.
 *   - No timers, no allocation, no floating point.
 *   - No Zephyr driver dependency; only Zephyr LOG_INF for the snapshot line
 *     and per-transition diagnostic logs.
 */

#include "devkit_app_state.h"

#include <stdbool.h>

#include "devkit_probe_adapter.h"
#include "probe_translator.h"

#include <zephyr/logging/log.h>

LOG_MODULE_REGISTER(devkit_app, LOG_LEVEL_INF);

static devkit_app_state_t s_state;
static uint32_t           s_transitions;
static uint32_t           s_button_count;
static uint32_t           s_uart_count;
static uint32_t           s_ignored_count;
static devkit_app_src_t   s_last_src;
static uint8_t            s_last_byte;

static const char *state_name(devkit_app_state_t s)
{
	switch (s) {
	case DEVKIT_APP_STATE_IDLE:   return "IDLE";
	case DEVKIT_APP_STATE_ARMED:  return "ARMED";
	case DEVKIT_APP_STATE_ACTIVE: return "ACTIVE";
	default:                      return "UNKNOWN";
	}
}

const char *devkit_app_state_state_name(devkit_app_state_t state)
{
	return state_name(state);
}

static const char *src_name(devkit_app_src_t s)
{
	switch (s) {
	case DEVKIT_APP_SRC_NONE: return "NONE";
	case DEVKIT_APP_SRC_BTN:  return "BTN";
	case DEVKIT_APP_SRC_UART: return "UART";
	default:                  return "UNKNOWN";
	}
}

/*
 * Apply a transition and emit a diagnostic line. Always increments
 * s_transitions when called; callers must skip this on no-op queries.
 */
static void transition(devkit_app_state_t next, devkit_app_src_t src,
		       uint32_t seq_or_count, uint8_t byte_or_zero)
{
	devkit_app_state_t prev = s_state;
	s_state = next;
	s_transitions++;

	if (src == DEVKIT_APP_SRC_BTN) {
		LOG_INF("Phase 9C app transition: %s->%s src=BTN seq=%u total=%u",
			state_name(prev), state_name(next),
			seq_or_count, s_transitions);
	} else if (src == DEVKIT_APP_SRC_UART) {
		LOG_INF("Phase 9C app transition: %s->%s src=UART byte=0x%02x count=%u total=%u",
			state_name(prev), state_name(next),
			(unsigned)byte_or_zero,
			seq_or_count, s_transitions);
	} else {
		LOG_INF("Phase 9C app transition: %s->%s src=%s total=%u",
			state_name(prev), state_name(next),
			src_name(src), s_transitions);
	}
}

void devkit_app_state_init(void)
{
	s_state         = DEVKIT_APP_STATE_IDLE;
	s_transitions   = 0u;
	s_button_count  = 0u;
	s_uart_count    = 0u;
	s_ignored_count = 0u;
	s_last_src      = DEVKIT_APP_SRC_NONE;
	s_last_byte     = 0u;
	LOG_INF("Phase 9C app state init: state=IDLE");
}

void devkit_app_state_on_button(uint32_t seq)
{
	s_button_count++;
	s_last_src = DEVKIT_APP_SRC_BTN;
	/* s_last_byte is preserved (button has no byte payload) */

	devkit_app_state_t next;
	uint32_t           probe_type = 0u;
	uint32_t           probe_arg0 = 0u;
	bool               probe_dispatch = false;

	switch (s_state) {
	case DEVKIT_APP_STATE_IDLE:
		next = DEVKIT_APP_STATE_ARMED;
		probe_type     = PROBE_ADAPTER_TYPE_CONFIG;
		probe_arg0     = PROBE_ADAPTER_ARG_NONE;
		probe_dispatch = true;
		break;
	case DEVKIT_APP_STATE_ARMED:
		next = DEVKIT_APP_STATE_ACTIVE;
		probe_type     = PROBE_ADAPTER_TYPE_COMMAND;
		probe_arg0     = PROBE_ADAPTER_ARG_START;
		probe_dispatch = true;
		break;
	case DEVKIT_APP_STATE_ACTIVE:
		next = DEVKIT_APP_STATE_IDLE;
		probe_type     = PROBE_ADAPTER_TYPE_COMMAND;
		probe_arg0     = PROBE_ADAPTER_ARG_RESET;
		probe_dispatch = true;
		break;
	default:
		next = DEVKIT_APP_STATE_IDLE;
		break;
	}
	transition(next, DEVKIT_APP_SRC_BTN, seq, 0u);

	/* Phase 12L: devkit-local probe dispatch on accepted state transition.
	 * Internal evidence only -- no UART behavior change. */
	if (probe_dispatch) {
		(void)devkit_probe_adapter_dispatch(probe_type, probe_arg0);
	}
}

void devkit_app_state_on_uart_byte(uint8_t byte, uint32_t handler_count)
{
	s_uart_count++;
	s_last_src  = DEVKIT_APP_SRC_UART;
	s_last_byte = byte;

	/* Case-insensitive ASCII command set; everything else is ignored. */
	uint8_t c = byte;
	if (c >= 'A' && c <= 'Z') {
		c = (uint8_t)(c + ('a' - 'A'));
	}

	switch (c) {
	case 'a':
		if (s_state != DEVKIT_APP_STATE_ARMED) {
			transition(DEVKIT_APP_STATE_ARMED, DEVKIT_APP_SRC_UART,
				   handler_count, byte);
			/* Phase 12L: devkit-local probe dispatch (internal). */
			(void)devkit_probe_adapter_dispatch(
				PROBE_ADAPTER_TYPE_CONFIG,
				PROBE_ADAPTER_ARG_NONE);
		} else {
			LOG_INF("Phase 9C app: 'a' ignored (already ARMED)");
			s_ignored_count++;
		}
		break;
	case 's':
		if (s_state != DEVKIT_APP_STATE_ACTIVE) {
			transition(DEVKIT_APP_STATE_ACTIVE, DEVKIT_APP_SRC_UART,
				   handler_count, byte);
			/* Phase 12L: devkit-local probe dispatch (internal). */
			(void)devkit_probe_adapter_dispatch(
				PROBE_ADAPTER_TYPE_COMMAND,
				PROBE_ADAPTER_ARG_START);
		} else {
			LOG_INF("Phase 9C app: 's' ignored (already ACTIVE)");
			s_ignored_count++;
		}
		break;
	case 'r':
		if (s_state != DEVKIT_APP_STATE_IDLE) {
			transition(DEVKIT_APP_STATE_IDLE, DEVKIT_APP_SRC_UART,
				   handler_count, byte);
			/* Phase 12L: devkit-local probe dispatch (internal). */
			(void)devkit_probe_adapter_dispatch(
				PROBE_ADAPTER_TYPE_COMMAND,
				PROBE_ADAPTER_ARG_RESET);
		} else {
			LOG_INF("Phase 9C app: 'r' ignored (already IDLE)");
			s_ignored_count++;
		}
		break;
	case '?':
		LOG_INF("Phase 9C app query: state=%s transitions=%u",
			state_name(s_state), s_transitions);
		/* '?' is a recognized query, not an ignored command. */
		break;
	case 'v':
		/* Phase 10B-v: build/version query. No state change; not an
		 * ignored command. Response is emitted by the UART TX path. */
		LOG_INF("Phase 10B-v build query: state=%s",
			state_name(s_state));
		break;
	case 'l':
		/* Phase 10B-L: LED physical-effect command. No app-state change;
		 * not an ignored command. The actual GPIO toggle is performed
		 * in the UART TX layer (devkit_uart_producer.c) so this module
		 * stays hardware-free. Case-insensitive: `L` and `l` both land
		 * here via the upcase normalization above. */
		LOG_INF("Phase 10B-L LED command: state=%s",
			state_name(s_state));
		break;
	case 't':
		/* Phase 11D: on-board MEMS accelerometer probe command.
		 * No app-state change; not an ignored command. Adapter-level
		 * probe: the actual sensor read (sensor_sample_fetch +
		 * sensor_channel_get) and the ACC/ERR response formatting are
		 * performed in the UART TX layer (devkit_uart_producer.c) so
		 * this module stays hardware-free. Case-insensitive: `T` and
		 * `t` both land here via the upcase normalization above.
		 * Spec: PHASE_11C_ACCEL_PROBE_SPEC.md §G. */
		LOG_INF("Phase 11D-T accel probe: state=%s",
			state_name(s_state));
		break;
	case 'd':
		/* Phase 10B-d: explicit disarm. ARMED -> IDLE with transition.
		 * IDLE: recognized no-op (not ignored -- distinct from 'r').
		 * ACTIVE: recognized no-op (USER_DECISION_REQUIRED_ACTIVE_DISARM).
		 * 'd' does not replace or alter 'r'. */
		if (s_state == DEVKIT_APP_STATE_ARMED) {
			transition(DEVKIT_APP_STATE_IDLE, DEVKIT_APP_SRC_UART,
				   handler_count, byte);
			/* Phase 12L: devkit-local probe dispatch (internal). */
			(void)devkit_probe_adapter_dispatch(
				PROBE_ADAPTER_TYPE_COMMAND,
				PROBE_ADAPTER_ARG_RESET);
		} else {
			LOG_INF("Phase 10B-d disarm no-op: state=%s",
				state_name(s_state));
		}
		break;
	default:
		s_ignored_count++;
		break;
	}
}

void devkit_app_state_get_snapshot(devkit_app_state_snapshot_t *out)
{
	if (out == NULL) {
		return;
	}
	out->state         = s_state;
	out->transitions   = s_transitions;
	out->button_count  = s_button_count;
	out->uart_count    = s_uart_count;
	out->ignored_count = s_ignored_count;
	out->last_src      = s_last_src;
	out->last_byte     = s_last_byte;
}

void devkit_app_state_log_snapshot(void)
{
	LOG_INF("ROBOTOS_APP state=%s transitions=%u button=%u uart=%u "
		"ignored=%u last_src=%s last_byte=0x%02x",
		state_name(s_state),
		s_transitions,
		s_button_count,
		s_uart_count,
		s_ignored_count,
		src_name(s_last_src),
		(unsigned)s_last_byte);
}
```

## src/devkit_app_state.h
```c
/*
 * devkit_app_state.h
 * RobotOS devkit minimal application state machine (Phase 9C).
 *
 * Composes two real event sources (Phase 9A button USER+2 and
 * Phase 9B UART USER+3) into a tiny three-state machine. The first proof
 * that RobotOS-routed events from distinct hardware classes can drive
 * application-level behavior without any core/platform change.
 *
 * State machine:
 *
 *   +------+   button   +-------+   button   +--------+   button   +------+
 *   | IDLE |----------->| ARMED |----------->| ACTIVE |----------->| IDLE |
 *   +------+            +-------+            +--------+            +------+
 *      ^                                                              |
 *      |  uart 'r'/'R'                                                |
 *      +--------------------------------------------------------------+
 *
 *   uart 'a'/'A' -> ARMED   (from any state)
 *   uart 's'/'S' -> ACTIVE  (from any state)
 *   uart 'r'/'R' -> IDLE    (from any state)
 *   uart 'd'/'D' -> IDLE    (from ARMED only; recognized no-op from IDLE;
 *                             ACTIVE disarm is USER_DECISION_REQUIRED)
 *   uart 't'/'T' -> accelerometer probe (Phase 11D); no state change,
 *                   not ignored; ACC/ERR response emitted by UART TX path
 *   uart '?'     -> report current state only, no transition
 *   any other    -> ignored (incremented in ignored counter)
 *
 * Architectural shape (Phase 9C):
 *   - DEVKIT-LOCAL ONLY. No core/platform/Zephyr surface added.
 *   - Module is reentrancy-free: all entry points are called from the core
 *     dispatcher thread (button and UART handlers) or the devkit runtime
 *     thread (init / periodic log). Single CPU, single-threaded; no locks.
 *   - No new event types; no new core API; no admission/scheduler change.
 *   - No timers, dynamic allocation, or floating point.
 *   - Handler ownership is unchanged: button/UART producer handlers stay
 *     in their respective modules and *call into* this app module after
 *     their existing per-event work.
 */

#ifndef DEVKIT_APP_STATE_H
#define DEVKIT_APP_STATE_H

#include <stdint.h>

typedef enum {
	DEVKIT_APP_STATE_IDLE   = 0,
	DEVKIT_APP_STATE_ARMED  = 1,
	DEVKIT_APP_STATE_ACTIVE = 2,
} devkit_app_state_t;

typedef enum {
	DEVKIT_APP_SRC_NONE = 0,
	DEVKIT_APP_SRC_BTN  = 1,
	DEVKIT_APP_SRC_UART = 2,
} devkit_app_src_t;

typedef struct {
	devkit_app_state_t state;
	uint32_t           transitions;    /* total state changes */
	uint32_t           button_count;   /* button semantic events seen */
	uint32_t           uart_count;     /* UART bytes seen by app */
	uint32_t           ignored_count;  /* UART bytes that did not match any command */
	devkit_app_src_t   last_src;       /* source of the most recent input */
	uint8_t            last_byte;      /* last UART byte (low 8 bits); 0 if none */
} devkit_app_state_snapshot_t;

/*
 * Reset state, counters, and last-input fields. Must be called once at
 * runtime init, before any producer feeds events to this module.
 */
void devkit_app_state_init(void);

/*
 * Drive the state machine from a Phase 9A button event (USER+2).
 *
 * Cycles IDLE -> ARMED -> ACTIVE -> IDLE on every accepted-and-dispatched
 * button event. The seq argument is the button producer's per-event sequence;
 * stored only for the per-transition diagnostic log.
 *
 * Thread context only (must be called from devkit_button_handler).
 */
void devkit_app_state_on_button(uint32_t seq);

/*
 * Drive the state machine from a Phase 9B UART byte event (USER+3).
 *
 * Recognized commands (case-insensitive ASCII):
 *   'a' / 'A' -> ARMED
 *   's' / 'S' -> ACTIVE
 *   'r' / 'R' -> IDLE
 *   'd' / 'D' -> IDLE (from ARMED); no-op from IDLE; ACTIVE USER_DECISION_REQUIRED
 *   't' / 'T' -> accelerometer probe (Phase 11D); no transition, not ignored
 *   '?'       -> report current state (no transition)
 *   any other -> ignored (counter incremented; no transition)
 *
 * Thread context only (must be called from devkit_uart_handler).
 */
void devkit_app_state_on_uart_byte(uint8_t byte, uint32_t handler_count);

/*
 * Snapshot the current state and counters into a caller-owned struct.
 * If out is NULL the call is a no-op.
 */
void devkit_app_state_get_snapshot(devkit_app_state_snapshot_t *out);

/*
 * Return the canonical name string for a state enum value.
 * Returns "IDLE", "ARMED", "ACTIVE", or "UNKNOWN" for out-of-range values.
 * Result is a string literal (read-only); safe to call from thread context.
 * Added Phase 9E so devkit_uart_producer can format UART TX responses without
 * duplicating the name-lookup logic.
 */
const char *devkit_app_state_state_name(devkit_app_state_t state);

/*
 * Emit one ROBOTOS_APP log line via Zephyr LOG_INF.
 *
 * Stable single-line format (state and source names only; integers/hex):
 *   ROBOTOS_APP state=NAME transitions=N button=N uart=N ignored=N \
 *               last_src=NAME last_byte=0xNN
 *
 * Where NAME for state ∈ {IDLE, ARMED, ACTIVE} and last_src ∈ {NONE, BTN, UART}.
 *
 * Thread context only (Zephyr LOG_INF deferred path; not safe in ISR).
 */
void devkit_app_state_log_snapshot(void);

#endif /* DEVKIT_APP_STATE_H */
```

## src/devkit_build_info.c
```c
/*
 * devkit_build_info.c
 * Logs board, Zephyr version, build timestamp, and runtime config at boot.
 * Uses generated version.h for KERNEL_VERSION_STRING (confirmed in build/).
 */

#include "devkit_build_info.h"
#include "devkit_runtime.h"

#include <version.h>
#include <zephyr/logging/log.h>

LOG_MODULE_REGISTER(devkit_build_info, LOG_LEVEL_INF);

void devkit_build_info_log(void)
{
	LOG_INF("RobotOS devkit build info:");
	LOG_INF("  board=" CONFIG_BOARD);
	LOG_INF("  zephyr=" KERNEL_VERSION_STRING);
	LOG_INF("  build=" __DATE__ " " __TIME__);
	LOG_INF("  tick_ms=%d", DEVKIT_TICK_MS);
	LOG_INF("  log_backend=RTT");
}
```

## src/devkit_build_info.h
```c
/*
 * devkit_build_info.h
 * Build-time metadata log for RobotOS devkit.
 */

#ifndef DEVKIT_BUILD_INFO_H
#define DEVKIT_BUILD_INFO_H

void devkit_build_info_log(void);

#endif /* DEVKIT_BUILD_INFO_H */
```

## src/devkit_button_producer.c
```c
/*
 * devkit_button_producer.c
 * RobotOS devkit user-button event producer (Phase 9A-A) — devkit-local.
 *
 * Bridges STM32F411E-DISCO user button (PA0, alias sw0) to the portable
 * RobotOS core event pipeline. ISR posts via robotos_core_post_event()
 * under the Phase 5G ISR-safe contract.
 *
 * Implementation notes:
 *   - Zephyr GPIO/devicetree/interrupt usage is contained in this file only.
 *   - core/ and platform/ remain Zephyr-free and button-agnostic.
 *   - Phase 9A-B: timestamp guard (k_uptime_get_32) rejects ISR firings arriving
 *     within DEVKIT_BUTTON_DEBOUNCE_MS of the last accepted event. Purely devkit-
 *     local; no core API changed.
 *   - Counters are simple volatile uint32 in ISR; benign torn-read tolerated
 *     under the existing single-CPU model. Reads occur in thread context
 *     during periodic RTT cadence — single-tick skew is acceptable for a
 *     diagnostic counter.
 */

#include "devkit_button_producer.h"

#include <stdint.h>

#include <zephyr/kernel.h>
#include <zephyr/device.h>
#include <zephyr/devicetree.h>
#include <zephyr/drivers/gpio.h>
#include <zephyr/logging/log.h>

#include "robotos_core.h"
#include "devkit_app_state.h"

LOG_MODULE_REGISTER(devkit_btn, LOG_LEVEL_INF);

/*
 * Resolve the user button via the standard Zephyr 'sw0' alias.
 * Confirmed in zephyr/boards/arm/stm32f411e_disco/stm32f411e_disco.dts:
 *   user_button { gpios = <&gpioa 0 GPIO_ACTIVE_HIGH>; ... };
 *   aliases { sw0 = &user_button; ... };
 */
#define BTN_NODE DT_ALIAS(sw0)

#if !DT_NODE_HAS_STATUS(BTN_NODE, okay)
#error "Phase 9A-A requires devicetree alias 'sw0' to be present and okay"
#endif

static const struct gpio_dt_spec s_button = GPIO_DT_SPEC_GET(BTN_NODE, gpios);
static struct gpio_callback     s_button_cb_data;

/*
 * Volatile: written from GPIO ISR callback context, read from thread context.
 * Benign approximate counters under the single-CPU Cortex-M4 model.
 */
static volatile uint32_t s_attempted;
static volatile uint32_t s_ok;
static volatile uint32_t s_full;
static volatile uint32_t s_debounce_filtered; /* Phase 9A-B: firings suppressed by time-guard */
static volatile uint32_t s_invalid;
static volatile uint32_t s_other;

/*
 * Phase 9A-B: debounce timestamp. Holds the k_uptime_get_32() value from the
 * last accepted ISR firing. Initialised to 0; the first firing is always
 * accepted (elapsed = now - 0 >= DEVKIT_BUTTON_DEBOUNCE_MS at any real uptime).
 * Written only from ISR context; read only from ISR context — no torn-read risk.
 */
static volatile uint32_t s_last_accepted_ms;

/* Thread context only (handler runs from core dispatch in tick context). */
static uint32_t s_handled;

/*
 * Sequence counter for events. Updated only from ISR context (Zephyr serializes
 * GPIO callbacks per device on a single CPU). Static-init to 1 so first event
 * has seq=1.
 */
static uint32_t s_seq = 1u;

/*
 * Button GPIO ISR callback (Phase 5G ISR-safe contract).
 *
 * Forbidden in this context:
 *   - logging (LOG_INF/etc. backend may sleep)
 *   - sleeping / yielding
 *   - dispatching events
 *   - registering/unregistering handlers
 *   - allocating
 *
 * Permitted:
 *   - O(1) event construction on stack
 *   - robotos_core_post_event() (proven ISR-safe in Phase 5G/6G/6H/6I/6Z)
 *   - simple counter updates
 */
static void devkit_button_isr_cb(const struct device *dev,
				  struct gpio_callback *cb,
				  uint32_t pins)
{
	(void)dev;
	(void)cb;
	(void)pins;

	s_attempted++;

	/*
	 * Phase 9A-B debounce guard. k_uptime_get_32() is ISR-safe (reads a
	 * Zephyr kernel uptime counter with no locking / sleeping path).
	 * Unsigned subtraction wraps correctly on 32-bit rollover; the guard
	 * degrades gracefully at the ~49-day uptime wrap boundary.
	 */
	uint32_t now_ms = k_uptime_get_32();
	if ((now_ms - s_last_accepted_ms) < DEVKIT_BUTTON_DEBOUNCE_MS) {
		s_debounce_filtered++;
		s_seq++;
		return;
	}
	s_last_accepted_ms = now_ms;

	robotos_event_t ev = {
		.type           = DEVKIT_BUTTON_PRODUCER_TYPE,
		.timestamp_tick = 0u,
		.arg0           = DEVKIT_BUTTON_PRODUCER_MARKER,
		.arg1           = s_seq,
	};

	robotos_core_status_t r = robotos_core_post_event(&ev);
	switch (r) {
	case ROBOTOS_CORE_OK:
		s_ok++;
		break;
	case ROBOTOS_CORE_ERR_FULL:
		s_full++;
		break;
	case ROBOTOS_CORE_ERR_INVALID_ARG:
		s_invalid++;
		break;
	default:
		s_other++;
		break;
	}

	s_seq++;
}

/*
 * Devkit-local handler for DEVKIT_BUTTON_PRODUCER_TYPE.
 * Runs in thread context from the core dispatcher (one event per tick under
 * the unchanged ROBOTOS_CORE_MAX_EVENTS_PER_TICK = 1 budget).
 *
 * Validates the marker as a defensive sanity check; should never fail under
 * normal Phase 9A-A operation since this is the only producer of USER+2.
 */
static robotos_core_status_t devkit_button_handler(
	const robotos_event_t *event,
	void                  *user_context)
{
	(void)user_context;

	if (event == NULL) {
		return ROBOTOS_CORE_ERR_NULL;
	}
	if (event->type != DEVKIT_BUTTON_PRODUCER_TYPE ||
	    event->arg0 != DEVKIT_BUTTON_PRODUCER_MARKER) {
		LOG_ERR("Phase 9A button: unexpected event type=%d arg0=0x%x",
			(int)event->type, (unsigned)event->arg0);
		return ROBOTOS_CORE_ERR_INVALID_ARG;
	}

	s_handled++;
	uint32_t seq = (uint32_t)event->arg1;

	/* Per-press milestone log. Cadence is bounded by user button press
	 * rate (mechanical, far below tick rate) so log noise is small. */
	LOG_INF("Phase 9A button handled seq=%u count=%u", seq, s_handled);

	/* Phase 9C: drive the devkit application state machine.
	 * Thread-context only; app state module is single-threaded by
	 * construction (dispatcher serializes handler invocations). */
	devkit_app_state_on_button(seq);

	return ROBOTOS_CORE_OK;
}

robotos_core_status_t devkit_button_producer_init(void)
{
	if (!device_is_ready(s_button.port)) {
		LOG_ERR("Phase 9A-A: button GPIO port not ready");
		return ROBOTOS_CORE_ERR_INVALID_STATE;
	}

	int rc = gpio_pin_configure_dt(&s_button, GPIO_INPUT);
	if (rc < 0) {
		LOG_ERR("Phase 9A-A: gpio_pin_configure_dt failed: %d", rc);
		return ROBOTOS_CORE_ERR_INVALID_STATE;
	}

	rc = gpio_pin_interrupt_configure_dt(&s_button, GPIO_INT_EDGE_TO_ACTIVE);
	if (rc < 0) {
		LOG_ERR("Phase 9A-A: gpio_pin_interrupt_configure_dt failed: %d", rc);
		return ROBOTOS_CORE_ERR_INVALID_STATE;
	}

	/*
	 * Register the handler BEFORE enabling the interrupt so that any
	 * very-early press (e.g. user holding the button at boot) routes to
	 * the registered handler instead of incrementing unhandled_event_count.
	 */
	robotos_core_status_t hr = robotos_core_register_event_handler(
		DEVKIT_BUTTON_PRODUCER_TYPE,
		devkit_button_handler,
		NULL);
	if (hr != ROBOTOS_CORE_OK) {
		LOG_ERR("Phase 9A-A: handler register failed: %d", (int)hr);
		return hr;
	}

	gpio_init_callback(&s_button_cb_data, devkit_button_isr_cb, BIT(s_button.pin));

	rc = gpio_add_callback(s_button.port, &s_button_cb_data);
	if (rc < 0) {
		LOG_ERR("Phase 9A-A: gpio_add_callback failed: %d", rc);
		return ROBOTOS_CORE_ERR_INVALID_STATE;
	}

	LOG_INF("Phase 9A-B button producer init: type=USER+2 marker=0x%x pin=%s.%d debounce=%ums",
		(unsigned)DEVKIT_BUTTON_PRODUCER_MARKER,
		s_button.port->name,
		(int)s_button.pin,
		(unsigned)DEVKIT_BUTTON_DEBOUNCE_MS);
	return ROBOTOS_CORE_OK;
}

void devkit_button_producer_get_stats(devkit_button_producer_stats_t *out)
{
	if (out == NULL) {
		return;
	}
	out->attempted = s_attempted;
	out->ok        = s_ok;
	out->full      = s_full;
	out->debounce  = s_debounce_filtered;
	out->invalid   = s_invalid;
	out->other     = s_other;
	out->handled   = s_handled;
}

void devkit_button_producer_log_stats(void)
{
	devkit_button_producer_stats_t st;
	devkit_button_producer_get_stats(&st);
	LOG_INF("ROBOTOS_BTN attempted=%u ok=%u full=%u debounce=%u invalid=%u other=%u "
		"handled=%u type=USER+2",
		st.attempted, st.ok, st.full, st.debounce, st.invalid, st.other, st.handled);
}
```

## src/devkit_button_producer.h
```c
/*
 * devkit_button_producer.h
 * RobotOS devkit user-button event producer (Phase 9A-A).
 *
 * Thin devkit-local producer that bridges a real GPIO/EXTI hardware input
 * (the STM32F411E-DISCO user button, alias sw0) to the portable RobotOS
 * core event pipeline. The first non-synthetic event source for RobotOS:
 *
 *   PA0 user button rising edge
 *     -> Zephyr GPIO ISR callback
 *     -> robotos_core_post_event()           [Phase 5G ISR-safe contract]
 *     -> core queue
 *     -> robotos_core_tick() dispatcher      [thread context, budget=1/tick]
 *     -> button handler (devkit-local)
 *     -> ROBOTOS_BTN telemetry / Phase 9A milestone log
 *
 * Architectural shape (Phase 9A-A):
 *   - DEVKIT-LOCAL ONLY. Zephyr GPIO/devicetree usage is confined here.
 *     core/ and platform/ remain Zephyr-free and button-agnostic.
 *   - No new core API. No new platform abstraction (no robotos_platform_gpio).
 *   - No scheduler change. No new event type in the core enum (uses
 *     ROBOTOS_EVENT_USER + 2; see DEVKIT_BUTTON_PRODUCER_TYPE below).
 *   - Phase 5G ISR-safe contract: ISR posts via robotos_core_post_event(),
 *     does not log/sleep/dispatch/register/alloc.
 *   - No software debounce in 9A-A. Mechanical bounce, if observed, is
 *     documented but not fixed; a future phase may add devkit-local debounce.
 *
 * Hard non-goals (Phase 9A-A, deliberate):
 *   - No core/platform mutation.
 *   - No GPIO platform abstraction (premature; only one workload).
 *   - No threading, dynamic allocation, or floating point.
 *   - No telemetry feedback into scheduling.
 *   - No new Zephyr task/thread.
 */

#ifndef DEVKIT_BUTTON_PRODUCER_H
#define DEVKIT_BUTTON_PRODUCER_H

#include <stdint.h>

#include "robotos_core.h"

/*
 * Event type used by this producer. Distinct from:
 *   - Phase 6I producer:  ROBOTOS_EVENT_USER     (= 100)
 *   - Phase 6M producer:  ROBOTOS_EVENT_USER + 1 (= 101)
 *   - Phase 9A-A button:  ROBOTOS_EVENT_USER + 2 (= 102)  <-- this module
 *
 * Admissible per the Phase 4I admission gate (USER+ accepted).
 * No new core enum required.
 */
#define DEVKIT_BUTTON_PRODUCER_TYPE \
	((robotos_event_type_t)(ROBOTOS_EVENT_USER + 2u))

/* arg0 marker for runtime tagging / handler validation. */
#define DEVKIT_BUTTON_PRODUCER_MARKER 0x9A0Au

/*
 * Minimum elapsed time (ms) between two accepted button events.
 * ISR firings arriving within this window after an accepted event are counted
 * in the 'debounce' counter and discarded — no post to core queue.
 * Devkit-local compile-time constant; no core change required.
 * 30 ms comfortably spans typical STM32 mechanical contact bounce.
 */
#define DEVKIT_BUTTON_DEBOUNCE_MS 30u

/*
 * Producer-local counters. Distinct from core admission/drop counters
 * so the two views can be cross-checked in RTT.
 *
 *   attempted : every ISR firing increments this once
 *   ok        : robotos_core_post_event returned OK
 *   full      : returned ERR_FULL (queue at capacity)
 *   debounce  : ISR firings suppressed by the time-guard (Phase 9A-B)
 *   invalid   : returned ERR_INVALID_ARG (defensive; should always be 0)
 *   other     : any other non-OK return (defensive; should always be 0)
 *   handled   : button handler invocations (thread context)
 */
typedef struct {
	uint32_t attempted;
	uint32_t ok;
	uint32_t full;
	uint32_t debounce;
	uint32_t invalid;
	uint32_t other;
	uint32_t handled;
} devkit_button_producer_stats_t;

/*
 * Initialize the button producer:
 *   1. Verify sw0 GPIO device is ready.
 *   2. Configure pin as input.
 *   3. Configure interrupt: edge-triggered, active edge.
 *   4. Register the button event handler with core for
 *      DEVKIT_BUTTON_PRODUCER_TYPE.
 *   5. Install GPIO callback and enable interrupt.
 *
 * Must be called after robotos_core_init() so handler registration succeeds.
 *
 * Returns ROBOTOS_CORE_OK on success.
 * Returns ROBOTOS_CORE_ERR_INVALID_STATE if GPIO not ready or
 *         pin/interrupt configure fails.
 * Returns the underlying robotos_core_register_event_handler status if
 *         handler registration fails.
 *
 * Idempotent only in the sense that the producer counters are NOT reset on
 * a second call; however gpio_add_callback should not be called twice with
 * the same callback struct. Callers should call this exactly once.
 */
robotos_core_status_t devkit_button_producer_init(void);

/*
 * Snapshot the producer-local counters into a caller-owned struct.
 * If out is NULL, the call is a no-op.
 *
 * Reads volatile ISR counters in thread context. The values are a near-
 * coherent snapshot; readers tolerating single-tick skew are safe (the
 * RTT cadence sampling tolerates this by design).
 */
void devkit_button_producer_get_stats(devkit_button_producer_stats_t *out);

/*
 * Emit one ROBOTOS_BTN log line via Zephyr LOG_INF.
 *
 * Stable single-line format (integer fields only):
 *   ROBOTOS_BTN attempted=N ok=N full=N debounce=N invalid=N other=N handled=N type=USER+2
 *
 * Read-only: queries the producer's stats and logs them. Does not reset
 * counters or affect the producer. Thread-context only (Zephyr LOG_INF
 * deferred path; not safe to call from ISR).
 */
void devkit_button_producer_log_stats(void);

#endif /* DEVKIT_BUTTON_PRODUCER_H */
```

## src/devkit_fault.c
```c
/*
 * devkit_fault.c
 * Announces fault visibility at boot. Provides optional test panic (off by default).
 * To enable test panic: define DEVKIT_FAULT_TEST before including devkit_fault.h.
 */

#include "devkit_fault.h"

#include <zephyr/kernel.h>
#include <zephyr/logging/log.h>

LOG_MODULE_REGISTER(devkit_fault, LOG_LEVEL_INF);

void devkit_fault_init(void)
{
	LOG_INF("fault visibility active");
}

#ifdef DEVKIT_FAULT_TEST
void devkit_fault_test_panic(void)
{
	LOG_ERR("deliberate panic triggered — DEVKIT_FAULT_TEST");
	k_panic();
}
#endif
```

## src/devkit_fault.h
```c
/*
 * devkit_fault.h
 * Minimal fault visibility interface for RobotOS devkit.
 * DEVKIT_FAULT_TEST must be defined explicitly to expose the test panic.
 */

#ifndef DEVKIT_FAULT_H
#define DEVKIT_FAULT_H

void devkit_fault_init(void);

#ifdef DEVKIT_FAULT_TEST
void devkit_fault_test_panic(void);
#endif

#endif /* DEVKIT_FAULT_H */
```

## src/devkit_observability.c
```c
/*
 * devkit_observability.c
 * RobotOS devkit observability surface (Phase 6K).
 *
 * Bridges robotos_core_snapshot() to Zephyr LOG_INF for periodic RTT
 * visibility. Pure read-only -- never writes to core state, never
 * participates in scheduling/admission/dispatch/retry decisions.
 *
 * Field name discipline:
 *   - Field names match conventions established by the Phase 6I
 *     final-summary log (e.g. herr, bp, th_active) so existing RTT
 *     parsing tooling continues to work.
 *   - Line prefix is "ROBOTOS_OBS" so the periodic line is easy to
 *     grep separately from one-shot phase summaries.
 *
 * No dynamic allocation. No floating point. No string building on
 * the heap. The Zephyr LOG_INF macro handles deferred formatting.
 */

#include "devkit_observability.h"
#include "devkit_timer_producer.h"
#include "robotos_core.h"

#include <stdbool.h>
#include <stdint.h>
#include <zephyr/logging/log.h>

LOG_MODULE_REGISTER(devkit_obs, LOG_LEVEL_INF);

/*
 * ARMv7-M System Control Block fault registers (ARMv7-M ARM, B3.2.10).
 * Memory-mapped at fixed addresses for all Cortex-M3/M4/M7 devices.
 * Read is passive; status bits are write-1-to-clear, so reading does
 * not modify them.
 */
#define DEVKIT_OBS_SCB_CFSR_ADDR 0xE000ED28u
#define DEVKIT_OBS_SCB_HFSR_ADDR 0xE000ED2Cu

/* Map core state enum to a stable, short, parser-friendly name. */
static const char *state_name(robotos_core_state_t s)
{
	switch (s) {
	case ROBOTOS_CORE_STATE_UNINITIALIZED: return "UNINIT";
	case ROBOTOS_CORE_STATE_READY:         return "READY";
	case ROBOTOS_CORE_STATE_ERROR:         return "ERROR";
	default:                               return "UNKNOWN";
	}
}

void devkit_observability_log_snapshot(void)
{
	robotos_core_snapshot_t snap;
	robotos_core_status_t   ret = robotos_core_snapshot(&snap);

	if (ret != ROBOTOS_CORE_OK) {
		LOG_ERR("ROBOTOS_OBS snapshot_failed ret=%d", (int)ret);
		return;
	}

	LOG_INF("ROBOTOS_OBS state=%s ticks=%u pending=%u peak=%u "
		"dropped=%u dispatched=%u herr=%u throttled=%u "
		"rejected=%u accepted=%u unhandled=%u bp=%d th_active=%d",
		state_name(snap.state),
		snap.tick_count,
		snap.pending_event_count,
		snap.peak_queue_depth,
		snap.dropped_event_count,
		snap.dispatched_event_count,
		snap.handler_error_count,
		snap.producer_throttled_count,
		snap.admission_rejected_count,
		snap.admission_accepted_count,
		snap.unhandled_event_count,
		(int)snap.backpressure_active,
		(int)snap.producer_throttle_active);
}

/*
 * Phase 6L: read CFSR/HFSR directly from the SCB and emit a ROBOTOS_FAULT line.
 *
 * Sticky bits in these registers are write-1-to-clear; a plain read does
 * not modify them and is therefore safe to call repeatedly. No fault
 * recovery, no panic, no register clearing, no scheduling influence.
 *
 * Note: HFSR.DEBUGEVT may be set when a debugger has triggered a halt
 * event, even in the absence of an actual crash. Raw register values
 * are surfaced unfiltered so the operator can inspect the situation.
 */
void devkit_observability_log_fault(void)
{
	const volatile uint32_t *cfsr_reg =
		(const volatile uint32_t *)DEVKIT_OBS_SCB_CFSR_ADDR;
	const volatile uint32_t *hfsr_reg =
		(const volatile uint32_t *)DEVKIT_OBS_SCB_HFSR_ADDR;

	uint32_t cfsr = *cfsr_reg;
	uint32_t hfsr = *hfsr_reg;
	bool     active = (cfsr != 0u) || (hfsr != 0u);

	LOG_INF("ROBOTOS_FAULT active=%d cfsr=0x%08x hfsr=0x%08x context=%s",
		(int)active,
		(unsigned int)cfsr,
		(unsigned int)hfsr,
		active ? "fault" : "none");
}

/*
 * Phase 6M: emit ROBOTOS_PROD summary line.
 *
 * Field name discipline matches Phase 6I/6K conventions: integer counters,
 * one-line, stable key=value shape, grep-friendly. The "type=USER+1"
 * suffix is a literal string identifying the event type used by the
 * producer; it is stable across builds because the producer's event type
 * is a compile-time constant.
 */
void devkit_observability_log_producer_stats(void)
{
	devkit_timer_producer_stats_t st;
	devkit_timer_producer_get_stats(&st);

	LOG_INF("ROBOTOS_PROD attempted=%u ok=%u throttled=%u dropped=%u "
		"invalid=%u other=%u type=USER+1",
		st.attempted,
		st.ok,
		st.throttled,
		st.dropped,
		st.invalid,
		st.other);
}
```

## src/devkit_observability.h
```c
/*
 * devkit_observability.h
 * RobotOS devkit observability surface (Phase 6K).
 *
 * Provides a single one-line log of the robotos_core_snapshot() for
 * periodic visibility on hardware/devkit RTT logs.
 *
 * Passive: reads core state via the existing snapshot API and emits
 * a stable, grep-friendly LOG_INF line. Does NOT participate in
 * scheduling, dispatch, admission, throttle, or retry decisions.
 *
 * Thread-context only. Not safe to call from ISR (snapshot uses
 * platform critical section internally; the log macro itself is the
 * Zephyr LOG_INF deferred path which is thread-safe but we keep the
 * helper devkit-thread-only by convention).
 */

#ifndef DEVKIT_OBSERVABILITY_H
#define DEVKIT_OBSERVABILITY_H

#include <stdint.h>

/*
 * Log cadence: emit one ROBOTOS_OBS line every N runtime ticks.
 * At DEVKIT_TICK_MS = 500, N = 10 means once every ~5 seconds.
 * Bounded log rate by design; not configurable at runtime.
 */
#define DEVKIT_OBSERVABILITY_LOG_INTERVAL_TICKS 10u

/*
 * Capture a core snapshot and emit one ROBOTOS_OBS log entry.
 *
 * Stable line shape (single line, integer/boolean fields only):
 *   ROBOTOS_OBS state=<NAME> ticks=N pending=N peak=N dropped=N
 *               dispatched=N herr=N throttled=N rejected=N accepted=N
 *               unhandled=N bp=0|1 th_active=0|1
 *
 * If the snapshot API fails, a single error line is emitted instead
 * and the function returns; no fault is reported, no retry is performed.
 */
void devkit_observability_log_snapshot(void);

/*
 * Phase 6M: emit one ROBOTOS_PROD log line summarising the
 * devkit_timer_producer counters.
 *
 * Stable single-line format (integer fields only):
 *   ROBOTOS_PROD attempted=N ok=N throttled=N dropped=N invalid=N other=N type=USER+1
 *
 * Read-only: queries the producer's stats snapshot and logs them. Does
 * not reset counters, does not affect the producer's cadence, does not
 * influence runtime decisions. Thread-context only.
 */
void devkit_observability_log_producer_stats(void);

/*
 * Phase 6L: capture and log Cortex-M fault diagnostic registers.
 *
 * Reads CFSR (0xE000ED28) and HFSR (0xE000ED2C) directly from the
 * ARMv7-M System Control Block and emits one ROBOTOS_FAULT log entry.
 *
 * Stable line shape:
 *   ROBOTOS_FAULT active=0|1 cfsr=0x........ hfsr=0x........ context=<NAME>
 *
 * "active" = (cfsr != 0) || (hfsr != 0). "context" is a coarse string
 * hint -- "none" when active=0, "fault" otherwise. Bit-level decoding
 * (UFSR/BFSR/MMFSR sub-fields, BFAR/MMFAR) is intentionally out of scope
 * for this phase and reserved for a future fault-decoding phase.
 *
 * Passive read-only: does NOT clear fault status (CFSR/HFSR are
 * write-1-to-clear; reading is non-destructive), does NOT panic,
 * does NOT trigger recovery, does NOT influence scheduling.
 *
 * Cortex-M only. Uses direct SCB memory access; no CMSIS header
 * dependency. Thread-context only (snapshot critical section is
 * unaffected; this helper holds no lock).
 */
void devkit_observability_log_fault(void);

#endif /* DEVKIT_OBSERVABILITY_H */
```

## src/devkit_probe_adapter.c
```c
/*
 * devkit_probe_adapter.c
 *
 * RobotOS devkit -- probe_translator runtime adapter (Phase 12L).
 *
 * Implements the public API declared in devkit_probe_adapter.h. Owns the
 * module-static probe_translator_t instance and bridges devkit-side command
 * signals to the probe_translator public API.
 *
 * Spec anchor:
 *   RobotOS_v1.0/devkit/docs/03_SPECS/PROBE_TRANSLATOR_RUNTIME_ADMISSION_PLAN.md
 *
 * Implementation notes:
 *   - The probe_translator is build-admitted to the devkit Zephyr image
 *     at Phase 12K. This module is the runtime admission point (Phase 12L).
 *   - The static probe_translator_t lives for the lifetime of the devkit
 *     process; its embedded fsm + bridge configs satisfy the Framework
 *     lifetime contract by construction.
 *   - No heap. No scheduler call. No ISR-context call. No UART include.
 *   - All entry points are thread-context only. Callers are the core
 *     dispatcher thread (devkit_app_state on_uart_byte / on_button) and
 *     the devkit runtime thread (init / periodic log).
 */

#include "devkit_probe_adapter.h"

#include <stdbool.h>

#include "probe_translator.h"

#include <zephyr/logging/log.h>

LOG_MODULE_REGISTER(devkit_probe, LOG_LEVEL_INF);

static probe_translator_t s_probe_translator;
static bool               s_initialized;

robotos_core_status_t devkit_probe_adapter_init(void)
{
	robotos_core_status_t st;

	s_initialized = false;

	st = probe_translator_init(&s_probe_translator, NULL);
	if (st != ROBOTOS_CORE_OK) {
		LOG_ERR("ROBOTOS_PROBE init failed: %d", (int)st);
		return st;
	}

	s_initialized = true;
	LOG_INF("ROBOTOS_PROBE init ok");
	return ROBOTOS_CORE_OK;
}

robotos_core_status_t devkit_probe_adapter_dispatch(
	uint32_t adapter_type, uint32_t adapter_arg0)
{
	robotos_core_status_t st;

	if (!s_initialized) {
		LOG_WRN("ROBOTOS_PROBE dispatch skipped: not initialized "
			"(type=%u arg0=%u)",
			(unsigned)adapter_type, (unsigned)adapter_arg0);
		return ROBOTOS_CORE_ERR_INVALID_STATE;
	}

	st = probe_translator_dispatch_adapter_event(
		&s_probe_translator, adapter_type, adapter_arg0, NULL);
	if (st != ROBOTOS_CORE_OK) {
		LOG_WRN("ROBOTOS_PROBE dispatch err type=%u arg0=%u ret=%d",
			(unsigned)adapter_type, (unsigned)adapter_arg0, (int)st);
	}
	return st;
}

void devkit_probe_adapter_log_snapshot(void)
{
	probe_translator_snapshot_t snap;
	robotos_core_status_t st;

	if (!s_initialized) {
		return;
	}

	st = probe_translator_get_snapshot(&s_probe_translator, &snap);
	if (st != ROBOTOS_CORE_OK) {
		LOG_WRN("ROBOTOS_PROBE snapshot err: %d", (int)st);
		return;
	}

	LOG_INF("ROBOTOS_PROBE state=%u trans=%u events=%u no_trans=%u "
		"mapped=%u unmapped=%u",
		(unsigned)snap.fsm.current_state,
		(unsigned)snap.fsm.transition_count,
		(unsigned)snap.fsm.event_count,
		(unsigned)snap.fsm.no_transition_count,
		(unsigned)snap.bridge.mapped_count,
		(unsigned)snap.bridge.unmapped_count);
}
```

## src/devkit_probe_adapter.h
```c
/*
 * devkit_probe_adapter.h
 *
 * RobotOS devkit -- probe_translator runtime adapter (Phase 12L).
 *
 * Owns the single static probe_translator_t instance inside the devkit and
 * exposes a three-function interface that bridges devkit_app_state command
 * signals to probe_translator adapter-key tuples. Devkit-local only.
 *
 * Spec anchor:
 *   RobotOS_v1.0/devkit/docs/03_SPECS/PROBE_TRANSLATOR_RUNTIME_ADMISSION_PLAN.md
 *
 * Boundaries (Phase 12L):
 *   - No #include of probe_translator.h or framework headers from this
 *     header. The adapter's internal state is owned by .c only.
 *   - No UART TX. No hardware driver API. No Zephyr driver API.
 *   - No new robotos_core_register_event_handler() call.
 *   - All entry points are thread-context only (never ISR).
 *   - Adapter is additive observation: dispatch failures are logged and
 *     not propagated to callers (devkit_app_state must not fail a UART
 *     command due to probe_translator state).
 */

#ifndef DEVKIT_PROBE_ADAPTER_H
#define DEVKIT_PROBE_ADAPTER_H

#include <stdint.h>

#include "robotos_core.h"

#ifdef __cplusplus
extern "C" {
#endif

/*
 * Initialize the probe adapter. Calls probe_translator_init() internally
 * against the module-static probe_translator_t instance.
 *
 * Must be called once from devkit_runtime_init() after
 * devkit_app_state_init() and before any dispatch call.
 *
 * Return:
 *   ROBOTOS_CORE_OK         on success; adapter ready for dispatch.
 *   Any non-OK              from probe_translator_init(); adapter is left
 *                           uninitialized and subsequent dispatch calls
 *                           are no-ops that return ROBOTOS_CORE_ERR_INVALID_STATE.
 *
 * Thread-context only.
 */
robotos_core_status_t devkit_probe_adapter_init(void);

/*
 * Dispatch a synthetic adapter event to the probe translator.
 *
 * adapter_type and adapter_arg0 are PROBE_ADAPTER_* constants defined in
 * app/probe_translator/probe_translator.h. The adapter must not interpret
 * them; it forwards them verbatim through the probe_translator public API.
 *
 * Non-OK return is logged at WRN level and returned to the caller; callers
 * (devkit_app_state) must treat the return as advisory and continue.
 *
 * Return:
 *   ROBOTOS_CORE_OK                 on a mapped or unmapped dispatch.
 *   ROBOTOS_CORE_ERR_INVALID_STATE  if the adapter is not initialized.
 *   Any non-OK from probe_translator_dispatch_adapter_event().
 *
 * Thread-context only.
 */
robotos_core_status_t devkit_probe_adapter_dispatch(
    uint32_t adapter_type, uint32_t adapter_arg0);

/*
 * Emit one ROBOTOS_PROBE log line via Zephyr LOG_INF with the
 * probe_translator FSM + bridge snapshot.
 *
 * Stable single-line format (integer fields only):
 *   ROBOTOS_PROBE state=%u trans=%u events=%u no_trans=%u
 *                 mapped=%u unmapped=%u
 *
 * No-op (silent return) if the adapter is not initialized.
 *
 * Thread-context only (Zephyr LOG_INF deferred path; not safe in ISR).
 */
void devkit_probe_adapter_log_snapshot(void);

#ifdef __cplusplus
}
#endif

#endif /* DEVKIT_PROBE_ADAPTER_H */
```
